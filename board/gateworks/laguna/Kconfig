## board/gateworks/laguna/Kconfig
```kconfig
if TARGET_GW_LAGUNA

config SYS_CPU
  string
  default "arm11mpcore"

config SYS_BOARD
  string
  default "laguna"

config SYS_VENDOR
  string
  default "gateworks"

config SYS_SOC
  string
  default "cavium"

config SYS_CONFIG_NAME
  string
  default "laguna"

endif
```

## configs/laguna_spi_defconfig
```kconfig
CONFIG_ARM=y
CONFIG_TARGET_GW_LAGUNA=y
CONFIG_SYS_EXTRA_OPTIONS="BOOT_FLASH_SPI"
```
